## CMakeLists.txt
```
cmake_minimum_required(VERSION 3.20.0)

set(CONF_FILE "prj.conf")
# if(DEBUG)
#list(APPEND CONF_FILE "fragment_file2.conf")
#else()
#endif()
find_package(Zephyr REQUIRED HINTS $ENV{ZEPHYR_BASE})

project(app)

include($ENV{ZEPHYR_BASE}/cmake/app/boilerplate.cmake NO_POLICY_SCOPE)

set(CMAKE_CXX_FLAGS "-std=c++17")
set(CMAKE_CXX_FLAGS_RELWITHDEBINFO "-O2 -ggdb")
set(CMAKE_CXX_FLAGS_DEBUG "-Og -ggdb")

#set(CMAKE_BUILD_TYPE "RelWithDebInfo")
file(GLOB SRC src/main3.cpp)

target_sources(${PROJECT_NAME} PRIVATE ${SRC})
target_include_directories(app PUBLIC
    ${CMAKE_SOURCE_DIR}/include
)

#cmake_minimum_required(VERSION 3.11)
#project(test)
#
#find_package(Zephyr REQUIRED)
#
##set(CMAKE_CXX_FLAGS "${CMAKE_CXX_FLAGS} -fpic -O0 -ggdb")
#file(GLOB SRC src/main3.cpp)
#target_sources(app PRIVATE
#    ${SRC}
#    )
##add_executable(${PROJECT_NAME} ${SRC})
#target_include_directories(app PUBLIC
#    ${CMAKE_SOURCE_DIR}/include
#    )
#add_subdirectory(test)
```

## prj.conf
```kconfig
CONFIG_CPP=y
CONFIG_GLIBCXX_LIBCPP=y
CONFIG_STD_CPP17=y
CONFIG_ZTEST=y
```

## include/linear_regression.h
```c
#pragma once

// https://github.com/aluxian/CPP-ML-LinearRegression/blob/master/LinearRegression.cpp
// https://helloacm.com/cc-linear-regression-tutorial-using-gradient-descent/
// http://www.johnwittenauer.net/machine-learning-exercises-in-python-part-1/

namespace numeric {

    template <typename T>
    class linear_regression {
        typedef T float_type;
        typedef std::valarray<float_type> va_type;
    public:
        linear_regression(const va_type& x, const va_type& y);


        void predict(float_type x[], float_type theta[], int m, float_type* res) {
            
        }

        void gradient_descent(float_type x[], const va_type& y, int iters, int m) {
            float_type theta[2] = { 1, 1 };

            std::valarray<T> predictions(m);

            for(int i=0; i < iters; ++i) {
                // calculate predictions
                predict(x, theta, m, &predictions[0]);
                auto diff = predictions - y;                
            }
        }
    };
}
```

## include/log.h
```c
#pragma once

#include <sstream>
#include <typeinfo>
#include <cxxabi.h>
#include <iterator>
#include <iostream>
#include <iomanip>
#include <date.h>

#define RESET   "\033[0m"
#define BLACK   "\033[30m"      /* Black */
#define RED     "\033[31m"      /* Red */
#define GREEN   "\033[32m"      /* Green */
#define YELLOW  "\033[33m"      /* Yellow */
#define BLUE    "\033[34m"      /* Blue */
#define MAGENTA "\033[35m"      /* Magenta */
#define CYAN    "\033[36m"      /* Cyan */
#define WHITE   "\033[37m"      /* White */

namespace io {

    enum class loglevel : uint8_t {
        quiet = 0,
        error,
        warn,
        info,
        all,
        none
    };

    class logstream : public std::ostringstream {
        std::ostream& _out;
        std::string _dtstring;
        std::string _context;
        loglevel _curlevel;
        loglevel _loglevel;
        static std::size_t _depth;
    public:
        logstream(std::ostream& out, const std::string& context, loglevel logl=loglevel::all) 
        : _out(out)
        , _dtstring("%F %T) //%Y%m%d %H:%M:%S") 
        , _context(context)
        , _curlevel(loglevel::none)
        , _loglevel(logl)
        {
            _out << logline((RED "+" RESET) + _context) << std::endl;
            _depth++;
        }

        virtual ~logstream() {
            flush();
            _depth--;
            _out << logline((RED "-" RESET) + _context) << std::endl;
        }

        static std::string logline(const std::string& what) {
            std::stringstream os;
            os << MAGENTA << date::format("%F %T", std::chrono::system_clock::now()) << RESET << " ";
            os << std::string(_depth, ' ');
            //os << std::setfill(' ') << std::setw(1) << " ";
            os << what;
            return os.str();
            //os.flush();
        }

        void flush() {
            if(_curlevel <= _loglevel) {
                _out << logline(str());
            }
            str("");
            _curlevel = loglevel::none;
        }

        template <typename T>
        inline logstream& operator << (const T& t)
        {
            (*(std::ostringstream*)this) << t;
            return *this;
        }

        
        logstream& operator << (const loglevel& l) {
            _curlevel = l;
            return *this;
        }

        typedef logstream & (*logstream_manip)(logstream &);
        logstream & operator<<(logstream_manip manip) { return manip(*this); }
    };

    template <typename R>
    static std::string value_of(const std::string& name, const R& val, bool print_type=false) {
        std::stringstream ss;
        ss << RESET << name;
        if(print_type) {
            int status = 0;
            auto ti = typeid(val).name();
            auto realname = abi::__cxa_demangle(ti, 0, 0, &status);
            ss << " (" << WHITE << realname << RESET << ")";
        }
        ss << "=[" << BLUE << val << RESET << "]";
        return ss.str();
    }

    std::size_t logstream::_depth = 0;

    //logstream& operator << (logstream& out, logstream::level lvl);
}
namespace std { 
    io::logstream & endl(io::logstream & out) { 
        out.put('\n'); 
        out.flush(); 
        return out; 
    } 
}

#define DEBUG_METHOD()              io::logstream __logstream(std::cout, __FUNCTION__) //; DEBUG_VALUE_OF(__FUNCTION__)
#define DEBUG_VALUE_OF(x)           __logstream << io::loglevel::info << io::value_of(#x, x, false) << std::endl
#define DEBUG_VALUE_AND_TYPE_OF(x)  __logstream << io::loglevel::info << io::value_of(#x, x, true) << std::endl
```

## include/map.h
```c
#pragma once

// https://stackoverflow.com/questions/40380447/python-like-map-in-c
template<template<class...>class Z, class C, class Op>
struct calculate_return_type {
  using dC = typename std::decay<C>::type;
  using T_in = typename dC::reference;
  using T_out = typename std::decay< typename std::result_of< Op&(T_in) >::type >::type;
  using R = Z<T_out>;
};

template <template<class...>class Z=std::vector, class C, class UnaryOperator>
auto map(C&& c_in, UnaryOperator&& operation)
-> typename calculate_return_type<Z, C, UnaryOperator>::R
{
  using R = typename calculate_return_type<Z, C, UnaryOperator>::R;
  R result;
  result.reserve(c_in.size());
  using T_in = typename calculate_return_type<Z, C, UnaryOperator>::T_in;

  using std::begin; using std::end;
  std::transform(
    begin(c_in), end(c_in),
    std::back_inserter(result),
    [&] (T_in item) { return operation(decltype(item)(item)); }
  );
  return result;
}
```

## include/memory.h
```c
#pragma once

#include <cstddef>
#include <cstring>
#define MAX(x, y) (((x) > (y)) ? (x) : (y))
#define MIN(x, y) (((x) < (y)) ? (x) : (y))

template <size_t N> class arena {
  static const size_t alignment = MAX(alignof(std::max_align_t), 16);

  alignas(alignment) char _buf[N];
  char *_ptr;

  bool ptr_in_buffer(char *p) { return _buf <= p && p <= _buf + N; }

public:
  arena() : _ptr(_buf) {}
  ~arena() { _ptr = nullptr; }

  char *alloc(size_t n) {
    if (_buf + N - _ptr >= n) {
      char *r = _ptr;
      _ptr += n;
      return r;
    }
    return static_cast<char *>(::operator new(n));
  }

  void dealloc(char *p, size_t n) {
    if (ptr_in_buffer(p)) {
      if (p + n == _ptr) {
        _ptr = p;
      }
    } else {
      ::operator delete(p);
    }
  }

  size_t used() const { return static_cast<size_t>(_ptr - _buf); }

  static arena &instance() {
    static arena *self = new arena{};
    return *self;
  }
};

class string {
  using pool = arena<1024>;
  size_t _size;
  size_t _cap;
  char *_m;

public:
  string(const char *str)
      : _size(strlen(str)), _cap(_size + 1), _m(pool::instance().alloc(_cap)) {
    strcpy(_m, str);
  }

  explicit string(const string &s)
      : _size(s.size()), _cap(_size + 1), _m(pool::instance().alloc(_cap)) {
    strcpy(_m, s.c_str());
  }

  size_t size() const { return _size; }

  void resize(size_t n) {
    if (n >= _cap) {
      string copy(*this);
      pool::instance().dealloc(_m, _size);
      _m = pool::instance().alloc(n + 1);
      strcpy(_m, copy._m);
      _cap = n;
    }
    _size = n;
    _m[_size] = '\0';
  }

  string &append(const string &other) {
    size_t n = other.size() + size();
    if (n >= _cap) {
      resize(n);
      strcat(_m, other._m);
    }
    return *this;
  }
  const char *c_str() const { return _m; }
};

template <typename T> class vector {
  using pool = arena<1024>;
  size_t _size;
  size_t _cap;
  T *_m;

public:
  vector(size_t sz) : _size(0), _cap(sz), _m(pool::instance().alooc(_cao)) {}
  ~vector() {}
  void push_back()
};
```

## include/net.h
```c
#pragma once

namespace net {
    namespace tcp {
    }

    namespace udp {
    }
}
```

## include/numeric.h
```c
#pragma once

namespace numeric {
    template <typename T, typename I>
    T mean(I first, I last) {
        return std::accumulate(first, last, static_cast<T>(0)) / std::distance(first, last);
    }

    template <typename T, typename C>
    T mean(const C& in) {
        return mean(std::begin(in), std::end(in));
    }

    template <typename T, typename I>
    T stddev(I first, I last, const T& mean) {
        T std = static_cast<T>(0);
        for(; first != last; ++first) {
            std += (*first - mean) * (*first - mean);
        }
        return std::sqrt(std / std::distance(first - last));
    }

    template <typename T, typename C>
    T stddev(const C& in, const T& mean) {
        return stddev(std::begin(in), std::end(in), mean);
    }

}
```

## include/tcp.h
```c
#pragma once


#include <functional>

namespace tcp {

    typedef std::function<void(int, int, const char*, uint16_t)> listen_callback;

    bool listen(int& sockfd, uint16_t port, const listen_callback& cb);
    bool open(int& sockfd, const std::string& ip, uint16_t port, int = 1000);
    bool close(int& sockfd);
    int send(int sockfd, const void* src, int len);
    int receive(int sockfd, void* dst, int len, int to_sec = 600);
    int set_blocking(int sockfd, bool val);
}
```

## include/zip.h
```c
#pragma once


#include <algorithm>
#include <iterator>
#include <iostream>

namespace cpp {


template<typename T>
class zip_impl
{
    
public:
    
    typedef std::vector<T> container_t;
    
    template<typename... Args>
    zip_impl(const T& head, const Args&... args)
    : items_(head.size()),
      min_(head.size())
    {
        zip_(head, args...);
    }
    
    inline operator container_t() const
    {
        return items_;
    }
    
    inline container_t operator()() const
    {
        return items_;
    }
    
private:
    
    template<typename... Args>
    void zip_(const T& head, const Args&... tail)
    {
        // If the current item's size is less than
        // the one stored in min_, reset the min_
        // variable to the item's size
        if (head.size() < min_) min_ = head.size();
        
        for (std::size_t i = 0; i < min_; ++i)
        {
            // Use begin iterator and advance it instead
            // of using the subscript operator adds support
            // for lists. std::advance has constant complexity
            // for STL containers whose iterators are
            // RandomAccessIterators (e.g. vector or deque)
            typename T::const_iterator itr = head.begin();
            
            std::advance(itr, i);
            
            items_[i].push_back(*itr);
        }
        
        // Recursive call to zip_(T, Args...)
        // while the expansion of tail... is not empty
        // else calls the overload with no parameters
        return zip_(tail...);
    }
 
    inline void zip_()
    {
        // If min_ has shrunk since the
        // constructor call
        items_.resize(min_);
    }
 
    /*! Holds the items for iterating. */
    container_t items_;
    
    /*! The minimum number of values held by all items */
    std::size_t min_;
    
};
 
template<typename T, typename... Args>
typename zip_impl<T>::container_t zip(const T& head, const Args&... tail)
{
    return zip_impl<T>(head, tail...);
}

}
```

## src/main3.cpp
```c
#include <vector>
#include "zip.hpp"
#include <iostream>

using wee::zip;

int main(int argc, char **argv) {
    auto a = std::vector<int> { 0, 1, 2 };
    auto b = std::vector<std::string> { "one", "two", "three" };

    for(auto&& [x, y] : zip(a, b)) {
        std::cout << x << " " << y << std::endl;
    }
  return 0;
}
```

## src/tcp.cpp
```c
#include "tcp.h"
#include <errno.h>
#include <memory.h>
#include <stdio.h>
#include <stdlib.h>
#include <memory>
#include <string>
#include <sstream>

#include <fcntl.h>
#include <sys/types.h>
#include <sys/socket.h>
#include <netdb.h>
#include <arpa/inet.h>
#include <thread>
#include <set>

#include <unistd.h>

namespace tcp {

	std::set<uint16_t> listening_ports;

	enum {
		TCP_OK = 0,
		TCP_ERROR = -1,
		TCP_TIMEOUT = -2
	};

	struct util { 

		static int select(int& sockfd, int to_sec) {
			fd_set fds;
			FD_ZERO(&fds);
			FD_SET(sockfd, &fds);

			struct timeval tv = as_timeval(to_sec);
			int n = ::select(sockfd + 1, &fds, NULL, NULL, &tv);
			return (n == -1 ? sockfd = -1, TCP_ERROR : n == 0 ? TCP_TIMEOUT : TCP_OK);
		}

		static int done(int sockfd, int flags, int error) {
			fcntl(sockfd, F_SETFL, flags);
			if(error) {
				::close(sockfd);
				errno = error;
				return -1;
			}
			return 0;
		}

		static struct timeval as_timeval(int to_sec) {
			struct timeval res;
			res.tv_sec = to_sec / 1000;
			res.tv_usec= (to_sec % 1000) * 1000;
			return res;
		}

		static int connect_nonb(int sockfd, const sockaddr* saptr, socklen_t salen, int to_sec) {
			int flags, n, error;
			socklen_t len;
			fd_set rset, wset;
			struct timeval tval;

			flags = fcntl(sockfd, F_GETFL, 0);
			fcntl(sockfd, F_SETFL, flags | O_NONBLOCK);

			error = 0;
			if((n=::connect(sockfd, (struct sockaddr*)saptr, salen)) < 0) 
				if(errno != EINPROGRESS)
					return false;

			if(n == 0) {
				return done(sockfd, flags, error);
			}

			FD_ZERO(&rset);
			FD_SET(sockfd, &rset);
			wset = rset;
			tval = as_timeval(to_sec);
			if((n=::select(sockfd + 1, &rset, &wset, NULL, to_sec > 0 ? &tval : NULL)) == 0) {
				::close(sockfd);
				errno = ETIMEDOUT;
				return -1;
			}

			if(FD_ISSET(sockfd, &rset) || FD_ISSET(sockfd, &wset)) {
				len = sizeof(error);
				if(::getsockopt(sockfd, SOL_SOCKET, SO_ERROR, &error, &len) < 0) {
					return -1;
				} 
			} else {
				return -1;
			}
			return done(sockfd, flags, error);
		}               
	};

	bool open(int& sockfd, const std::string& ip, uint16_t port, int to_sec) {
		addrinfo hints, *server_info;
		memset(&hints, 0, sizeof(hints));
		hints.ai_family     = AF_UNSPEC;
		hints.ai_socktype   = SOCK_STREAM;
		hints.ai_flags      = AI_PASSIVE;

		if(getaddrinfo(ip.c_str(), std::to_string(port).c_str(), &hints, &server_info) != 0) {
			return sockfd = -1, false;
		} 

		sockfd = ::socket(server_info->ai_family, server_info->ai_socktype, server_info->ai_protocol);

		bool res = tcp::util::connect_nonb(sockfd, server_info->ai_addr, server_info->ai_addrlen, to_sec) == 0;
		freeaddrinfo(server_info);

		return res;
	}

	bool close(int& sockfd) {
		if(sockfd != -1) {
			::shutdown(sockfd, SHUT_RDWR);
			::close(sockfd);
			sockfd = -1;
		}
		return true;
	}

	int send(int sockfd, const void* src, int len) {
		int sent = 0;
		do {
			int s = ::send(sockfd, &((char*)src)[sent], len - sent, 0);
			if(s == 0) return  0;
			if(s  < 0) return -1;

			sent += s;                    
		} while(sent <= len);
		/**
		  if(::shutdown(sockfd, SHUT_WR) < 0) {
		  return -1;
		  }
		  */
		return sent;
	}

	int set_blocking(int sockfd, bool val) {

		int flags = fcntl(sockfd, F_GETFL);
		if(!val) {
			flags |= O_NONBLOCK;
		} else {
			flags &= ~O_NONBLOCK;
		}

		if(fcntl(sockfd, F_SETFL, flags) < 0) {
			return -1;
		}
		return 0;
	}

	int receive(int sockfd, void* dst, int len, int to_sec) {
		if(sockfd < 0)
			return false;
		bool is_receiving = true;
		int bytes_recv = 0;
		while(is_receiving) {
			//if(to_sec > 0) {
			if(util::select(sockfd, to_sec) != TCP_OK) {
				return -1;
			}
			//}

			int rc = ::recv(sockfd, &((char*)dst)[bytes_recv], len - bytes_recv, 0);

			if(rc == 0) return  0;
			if(rc < 0)  return -1;

			bytes_recv += rc;

			is_receiving = bytes_recv != len;
		}
		return bytes_recv;
	}

	bool listen(int& sockfd, uint16_t port, const listen_callback& cb) {

		sockfd = ::socket(PF_INET, SOCK_STREAM, IPPROTO_TCP);
		struct sockaddr_in sa;
		::memset(&sa, 0, sizeof(struct sockaddr_in));
		sa.sin_family       = AF_INET;
		sa.sin_port         = htons(port);
		sa.sin_addr.s_addr  = INADDR_ANY;

		if(::bind(sockfd, (struct sockaddr*)&sa, sizeof(sa)) == - 1) {
			::close(sockfd);
			return false;
		}
		if(::listen(sockfd, 1024)) {
			::close(sockfd);
			return false;
		}

		volatile bool is_ready = false;

		std::thread([&] (volatile bool* ready_, int master_fd, const listen_callback& cb) {
				*ready_ = true;
				for(;;) {
				struct sockaddr_in sa;
				socklen_t sa_len = sizeof(sa);
				memset(&sa, 0, sa_len);

				int fd = ::accept(master_fd, (struct sockaddr*)&sa, &sa_len);
				if(fd < 0) {
				continue;
				}
				const char* sa_addr = inet_ntoa(sa.sin_addr);
				uint16_t sa_port    = ntohs(sa.sin_port);
				if(cb != nullptr) 
				cb(master_fd, fd, sa_addr, sa_port);
				}
				}, &is_ready, sockfd, cb).detach();

		while(!is_ready) 
			std::this_thread::sleep_for(std::chrono::milliseconds(1));
		listening_ports.insert(port);
		return true;
	} 
} // tcp
```
