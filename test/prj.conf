## CMakeLists.txt
```
cmake_minimum_required(VERSION 3.20)
find_package(Zephyr REQUIRED HINTS $ENV{ZEPHYR_BASE})
project(app)
file(GLOB SRC src/main.cpp)
target_sources(app PRIVATE ${SRC})
```

## prj.conf
```kconfig
CONFIG_CPP=y
CONFIG_GLIBCXX_LIBCPP=y
CONFIG_STD_CPP17=y
CONFIG_ZTEST=y
CONFIG_ZTEST_NEW_API=y
```

## src/main.cpp
```c
#include <zephyr/ztest.h>


ZTEST(testing, test_asserts) {
    zassert_true(1, "1 was false");
}

ZTEST(testing, test_foo) {
    zassert_false(0, "0 was true");
}

ZTEST_SUITE(testing, NULL, NULL, NULL, NULL, NULL);
```
